/*
 * Link layout for the Newton hypervisor — template shared by both host
 * platforms. The platforms differ only in the load address; build.rs
 * substitutes @IMAGE_BASE@ per the selected platform-* feature and
 * writes the resolved script to OUT_DIR/linker.ld:
 *
 *   platform-raspi3b  — 0x80000. QEMU raspi3b (and the real Pi 3B /
 *                       Zero 2 W firmware) load the aarch64 kernel
 *                       image at 0x80000 and jump to its first byte
 *                       with all cores.
 *   platform-fvp-base — 0x80000000. FVP loads an ELF via
 *                       `-a cluster0.cpu0=image.elf` by program-header
 *                       PA. Non-secure DRAM on the Base Platform
 *                       memory map starts at 0x80000000 and is 2 GiB
 *                       deep; we land the image at DRAM base and set
 *                       the FVP's cluster0.cpu0.RVBAR to match, giving
 *                       a direct EL2 entry when cluster0.has_el3=0.
 */

ENTRY(_start)

SECTIONS
{
    . = @IMAGE_BASE@;
    __image_start = .;

    .text.boot : { KEEP(*(.text.boot)) }

    /*
     * The embedded Newton ROM + REx (src/newton/loader.rs) sit right
     * after the boot stub, at a fixed 4 KiB offset from the image base,
     * ahead of everything that changes from build to build. The blob
     * is ~8.3 MiB and never changes for a given ROM version, so keeping
     * its image offset stable lets the serial loader's delta persist
     * (nhboot/src/persist.rs) leave those sectors of HYPERV.IMG alone;
     * placed after .text/.rodata it would shift on every code change.
     * Nothing depends on .text following .text.boot directly: boot.s
     * reaches the rest of the image with adrp/bl (±4 GiB / ±128 MiB).
     */
    . = ALIGN(4096);
    ASSERT(. - __image_start == 0x1000, ".text.boot must fit in the first 4 KiB")
    __rom_blob_start = .;
    .rom_blob  : { KEEP(*(.rom_blob.rom)) KEEP(*(.rom_blob.rex)) }
    __rom_blob_end = .;

    . = ALIGN(2048);   /* .text.vectors wants a 2 KiB-aligned VBAR. */
    .text      : { *(.text .text.*) }

    . = ALIGN(16);
    .rodata    : { *(.rodata .rodata.*) }

    . = ALIGN(16);
    .data      : { *(.data .data.*) }

    . = ALIGN(16);
    __bss_start = .;
    .bss (NOLOAD) : {
        *(.bss .bss.*)
        *(COMMON)
    }
    . = ALIGN(16);
    __bss_end = .;

    . = ALIGN(4096);
    /*
     * EL2 stack for core 0. The lowest 8 bytes hold a guard canary
     * (__stack_guard), seeded in boot.s and checked in trap_irq + the
     * halt paths: if the stack ever descends into it, the magic word is
     * clobbered and the next check loud-halts instead of letting an
     * overflow silently corrupt .bss below. Usable stack is therefore
     * (__stack_guard + 8 .. __stack_top].
     */
    __stack_guard = .;
    . = . + 0x4000;   /* 16 KiB stack for core 0 (incl. the guard word). */
    __stack_top = .;

    __image_end = .;

    /DISCARD/ : {
        *(.eh_frame)
        *(.eh_frame_hdr)
        *(.note .note.*)
        *(.comment)
    }
}
